## conf/layer.conf
```bitbake
# We have a conf and classes directory, add to BBPATH 
BBPATH .= ":${LAYERDIR}" 
# We have a packages directory, add to BBFILES 
BBFILES += "${LAYERDIR}/recipes-*/*/*.bb \ 
           ${LAYERDIR}/recipes-*/*/*.bbappend" 
BBFILE_COLLECTIONS += "meta-mediatek-demo" 
BBFILE_PATTERN_meta-mediatek-demo := "^${LAYERDIR}/" 
BBFILE_PRIORITY_meta-mediatek-demo := "6"

LAYERSERIES_COMPAT_meta-mediatek-demo = "warrior zeus dunfell kirkstone"
```
